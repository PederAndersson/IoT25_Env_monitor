## firmware/esp32/components/dht_11/Kconfig.projbuild
```kconfig
menu "DHT11 data-pin config"

    config APP_DHT_PIN_NUMBER
        int "Choose GPIO pin for the sensor"
        default 23
        help
            numbers to use: 0, 1, 2, 3, 6, 7, 14, 18, 19, 20, 21, 22, 23.

endmenu
```

## firmware/esp32/components/mqtt_service/Kconfig.projbuild
```kconfig
menu "IoT sensor MQTT configuration"

    config APP_MQTT_BROKER_URI
        string "MQTT broker URI"
        default ""
        help
            URI to the MQTT broker, mqtts://hostname:8883.

    config APP_MQTT_USERNAME
        string "MQTT username"
        default ""
        help
            Enter MQTT username.

    config APP_MQTT_PASSWORD
        string "MQTT password"
        default ""
        help
            Enter MQTT password.

    config APP_MQTT_TOPIC
        string "MQTT topic"
        default ""
        help
            Enter the MQTT topic.

endmenu
```

## firmware/esp32/components/telemetry_service/Kconfig.projbuild
```kconfig
menu "Telemetry queue length and interval"
    config APP_TELEMETRY_QUEUE_LEN
        int "Choose the length of the queue."
        range 10 120
        default 60
        help
            choose between 10-120

    config APP_TELEMETRY_SENSOR_READ_INTERVAL
        int "choose the interval between sensor readings."
        range 2000 3600000
        default 60000
        help
            remember interval is in ms between 2000 - 3600000

    config APP_TELEMETRY_ALARM_QUEUE_LEN
        int "Choose the length of the alarm queue"
        range 10 30
        default 10
        help
            choose between 10-30

endmenu
```

## firmware/esp32/components/wifi/Kconfig.projbuild
```kconfig
menu "IoT sensor Wi-Fi configuration"

    config APP_WIFI_SSID
        string "Wi-Fi SSID"
        default ""
        help
            Name of the Wi-Fi network that the ESP32 should connect to.

    config APP_WIFI_PASSWORD
        string "Wi-Fi password"
        default ""
        help
            Password for the Wi-Fi network. Do not place the real
            password in this Kconfig file.

    config APP_WIFI_MAXIMUM_RETRY
        int "Maximum connection retries"
        range 1 20
        default 5
        help
            Maximum number of reconnection attempts before the initial
            Wi-Fi connection is considered unsuccessful.

endmenu
```
